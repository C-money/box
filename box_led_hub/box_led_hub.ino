// Box LED Hub
// LED controller and slave to motion sense hub for box lighting effects

// Cole Hatton
// 15-0627
//  v0.3.1


#include <OctoWS2811.h>
#include <i2c_t3.h>


//OctoWS2811 Defn. Stuff
#define LONGEST_STRIP 110// all of the following params need to be adjusted for screen size
#define N_LED_OUTPUTS 3  // LED_LAYOUT assumed 0 if ROWS_LEDs > 8
#define N_LEDS    (LONGEST_STRIP * N_LED_OUTPUTS)

DMAMEM int displayMemory[LONGEST_STRIP * 6];
int drawingMemory[LONGEST_STRIP * 6];
const int config = WS2811_GRB | WS2811_800kHz;
OctoWS2811 leds(LONGEST_STRIP, displayMemory, drawingMemory, config);

#define N_STRIPS 11

//real vals, index off by 1 - int strip_lengths[N_STRIPS] = {21, 27, 27, 34, 29, 38, 29, 23, 29, 28, 24, 30, 28};
//int strip_lengths[N_STRIPS] = {21, 27, 27, 34, 29, 38, 29, 23, 48, 29, 24, 30, 55};
// new remapped values after for first box test
int strip_lengths[N_STRIPS] = {21, 27, 27, 35, 38, 29, 43, 28, 24, 30, 28};


#define STRIP_RED_LEVEL_MAX  1024
#define STRIP_RED_LEVEL_DEC  2
int strip_red_levels[N_STRIPS];// = {0, 0, 0, 0, 0, 0};
int strip_red_setpoints[N_STRIPS];// = {0, 0, 0, 0, 0, 0};

#define N_MOT_SENSORS 13

unsigned long frameCount=500;  // arbitrary seed to calculate the three time displacement variables t,t2,t3
uint16_t led_index = 0;
uint8_t strip_index = 0;

int incomingByte;
//Byte val 2PI Cosine Wave, offset by 1 PI 
//supports fast trig calcs and smooth LED fading/pulsing.

uint16_t const cos_wave_larger[2048] PROGMEM ={ 2047 ,  2047 , 2047 , 2047 , 2047 , 2047 , 2047 , 2047 , 2047 , 2047 , 2047 , 2046 , 2046 ,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 2047 , 2047 };

//Gamma Correction Curve
uint8_t const exp_gamma[256] PROGMEM =
{0,0,0,0,0,0,0,0,0,0,0,0,1,1,1,1,1,1,1,1,1,1,1,1,1,1,1,1,1,1,1,2,2,2,2,2,2,2,2,2,3,3,3,3,3,
4,4,4,4,4,5,5,5,5,5,6,6,6,7,7,7,7,8,8,8,9,9,9,10,10,10,11,11,12,12,12,13,13,14,14,14,15,15,
16,16,17,17,18,18,19,19,20,20,21,21,22,23,23,24,24,25,26,26,27,28,28,29,30,30,31,32,32,33,
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227,229,232,234,236,239,241,244,246,249,251,253,254,255
};

// Command definitions
#define WRITE    0x10
#define READ     0x20
#define SETRATE  0x30

// Function prototypes
void receiveEvent(size_t len);
void requestEvent(void);

// Memory
#define MEM_LEN 256
uint8_t mem[MEM_LEN];
uint8_t cmd;
size_t addr;
i2c_rate rate;
uint8_t i2c_update;

void setup()
{
  
  pinMode(LED_BUILTIN,OUTPUT); // LED
  
  
  rate = I2C_RATE_1200;
  
  // Setup for Slave mode, address 0x44, pins 18/19, external pullups, 400kHz
  Wire.begin(I2C_SLAVE, 0x44, I2C_PINS_18_19, I2C_PULLUP_EXT, rate);
  
  // init vars
  cmd = 0;
  addr = 0;
  memset(mem, 0, sizeof(mem));
  i2c_update = false;
  
  // register events
  Wire.onReceive(receiveEvent);
  Wire.onRequest(requestEvent);
  
  Serial.begin(115200);
  
  leds.begin();
  leds.show();
}


void loop()
{
  //Serial.print("loop\n");
  frameCount++;
  uint16_t t = fastCosineCalc((43 * frameCount)/50);  //time displacement - fiddle with these til it looks good...
  uint16_t t2 = -fastCosineCalc((35 * frameCount)/50); 
  uint16_t t3 = fastCosineCalc((37 * frameCount)/50);
  
  /*if (Serial.available() > 0) {
    incomingByte = Serial.read();
    /*switch (incomingByte) {
      case '0':
      strip_red_setpoints[0] = STRIP_RED_LEVEL_MAX;
      break;
      
      case '1':
      strip_red_setpoints[4] = STRIP_RED_LEVEL_MAX;
      break;
      
      case '2':
      strip_red_setpoints[5] = STRIP_RED_LEVEL_MAX;
      break;
    }*/
   /* if (incomingByte >= '0' && incomingByte < '0' + N_STRIPS) {
      strip_red_setpoints[incomingByte - '0'] = STRIP_RED_LEVEL_MAX;
    }
  }*/
  
  if (i2c_update) {
    i2c_update = false;
    
    for (uint8_t i = 0; i < N_MOT_SENSORS; i++) {
      if (mem[i] == 1) {
        strip_red_setpoints[i] = STRIP_RED_LEVEL_MAX;
      }
    }
  }
  
  for (int i = 0; i < N_STRIPS; i++) {
    if (strip_red_setpoints[i] > STRIP_RED_LEVEL_DEC) {
      strip_red_setpoints[i] -= STRIP_RED_LEVEL_DEC;
    } else {
      strip_red_setpoints[i] = 0;
    }
    strip_red_levels[i] = (strip_red_setpoints[i] + strip_red_levels[i] * 15) >> 4;    // recursive set point following
  }
      

  for (uint16_t x = 0; x < N_LEDS ; x++) {
    led_index++;
    if (led_index == strip_lengths[strip_index]) {
      led_index = 0;
      strip_index++;
      if (strip_index == N_STRIPS) {
        break;
      }
    }
    
    //Calculate 3 seperate plasma waves, one for each color channel
    uint16_t r = fastCosineCalc(((x*20) + (t3 >> 1) + fastCosineCalc(t2 + (x*20))));
    uint16_t g = fastCosineCalc((t + (x*20) + fastCosineCalc((-(t3 >> 2) + (x*20)))));
    uint16_t b = fastCosineCalc((t2 + (x*20) + fastCosineCalc((t + (x*20) + 0*(g >> 2)))));
    
    r = ((uint32_t)r * strip_red_levels[strip_index]) >> 13 ;
    g = g >> 4;
    b = b >> 4;    // bit shift of at least 3 needed for 8 bit color
//    r = 255;
//    g = 255;
//    b = 255;
    leds.setPixel(x, ((r << 16) | (g << 8) | b));
  }
  
  led_index = -1;    // should start at 0 after first inc
  strip_index = 0;
  
  digitalWrite(13, HIGH);
  leds.show();
  
  
  digitalWrite(13, LOW);
  delayMicroseconds(1000);
}


inline uint16_t fastCosineCalc( uint16_t preWrapVal)
{
  return cos_wave_larger[preWrapVal & 2047];//(pgm_read_byte_near(cos_wave_16+wrapVal)); 
}



/*void loop()
{
    digitalWrite(LED_BUILTIN,HIGH); // double pulse LED while waiting for I2C requests
    delay(10);                      // if the LED stops the slave is probably stuck in an ISR
    digitalWrite(LED_BUILTIN,LOW);
    delay(100);
    digitalWrite(LED_BUILTIN,HIGH);
    delay(10);
    digitalWrite(LED_BUILTIN,LOW);
    delay(880);
}*/

//
// handle Rx Event (incoming I2C request/data)
//
void receiveEvent(size_t len)
{
    if(Wire.available())
    {
        // grab command
        cmd = Wire.readByte();
        switch(cmd)
        {
        case WRITE:
            i2c_update = true;
            addr = Wire.readByte();                // grab addr
            while(Wire.available())
                if(addr < MEM_LEN)                 // drop data beyond mem boundary
                    mem[addr++] = Wire.readByte(); // copy data to mem
                else
                    Wire.readByte();               // drop data if mem full
            break;

        case READ:
            addr = Wire.readByte();                // grab addr
            break;

        case SETRATE:
            rate = (i2c_rate)Wire.readByte();      // grab rate
            Wire.setRate(rate);                    // set rate
            break;
        }
    }
}

//
// handle Tx Event (outgoing I2C data)
//
void requestEvent(void)
{
    switch(cmd)
    {
    case READ:
        Wire.write(&mem[addr], MEM_LEN-addr); // fill Tx buffer (from addr location to end of mem)
        break;
    }
}
